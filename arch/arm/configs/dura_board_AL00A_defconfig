## arch/arm/configs/dura_board_AL00A_defconfig
```kconfig
####dura64_board_AL00A_defconfig#####
CONFIG_MTK_MD1_SUPPORT=12
CONFIG_MTK_C2K_LTE_MODE=2
CONFIG_MTK_MD_SBP_CUSTOM_VALUE="0"
####dura64_board_AL00A_defconfig#####
CONFIG_CUSTOM_KERNEL_STEP_COUNTER=y
CONFIG_MTK_KX126_1063=y
CONFIG_MTK_BMA455=y
```

## arch/arm64/configs/dura64_board_default_defconfig
```kconfig
####dura64_board_default_defconfig####
CONFIG_MTK_MD1_SUPPORT=14
#CONFIG_MTK_C2K_LTE_MODE=2
CONFIG_MTK_MD_SBP_CUSTOM_VALUE="0"
####dura64_board_default_defconfig####
CONFIG_CUSTOM_KERNEL_SAR=y
CONFIG_MTK_SX9320=y
```

## drivers/devkit/tpkit/panel/Kconfig
```kconfig
#
# huawei touchscreen driver configuration
#
menuconfig SW_BRAND_HONOR
	bool "SW build with Brand Honor"
	default n


menuconfig SW_BRAND_HUAWEI
	bool "SW build with Brand Huawei"
	default n

source "drivers/devkit/tpkit/panel/focaltech/Kconfig"
source "drivers/devkit/tpkit/panel/synaptics/Kconfig"
source "drivers/devkit/tpkit/panel/parade/Kconfig"
source "drivers/devkit/tpkit/panel/novatek/Kconfig"
source "drivers/devkit/tpkit/panel/ilitek/Kconfig"
source "drivers/devkit/tpkit/panel/novatek_hybrid/Kconfig"
source "drivers/devkit/tpkit/panel/himax/Kconfig"
source "drivers/devkit/tpkit/panel/goodix/Kconfig"
source "drivers/devkit/tpkit/panel/mstar/Kconfig"
```

## drivers/input/touchscreen/mediatek/Kconfig
```kconfig
#
# Touchscreen driver configuration
#
menuconfig INPUT_TOUCHSCREEN
	bool "Touchscreens"
	help
	  Say Y here, and a list of supported touchscreens will be displayed.
	  This option doesn't affect the kernel.

	  If unsure, say Y.

if INPUT_TOUCHSCREEN

config TOUCHSCREEN_MTK
	bool "MediaTek Touch Panel Driver"
	help
	  Say Y here if you have MediaTek touch panel.

	  If unsure, say N.

	  To compile this dirver as a module, choose M here: the
	  module will be called.

config TOUCHSCREEN_PHYSICAL_ROTATION_WITH_LCM
	bool "MediaTek Touch Panel Rotation With LCM"
	default y
	help
	  Say N here if touch panel is not physical rotated as LCM does.
	  Physically rotated means that this driver will map
	  the reported coordination to diagonal position.

	  If unsure, say Y.

config TOUCHSCREEN_MTK_GT1151
	bool "GT1151 for Mediatek package"
	default n
	help
	  Say Y here if you have GT1151 touch panel.

	  If unsure, say N.

	  To compile this dirver as a module, choose M here: the
	  module will be called.

source "drivers/input/touchscreen/mediatek/GT1151/Kconfig"

config TOUCHSCREEN_MTK_GT5688
	bool "GT1151 for Mediatek package"
	default n
	help
	  Say Y here if you have GT5688 touch panel.

	  If unsure, say N.

	  To compile this dirver as a module, choose M here: the
	  module will be called.

source "drivers/input/touchscreen/mediatek/GT5688/Kconfig"

config TOUCHSCREEN_MTK_GT911
	bool "GT911 for Mediatek package"
	help
	  Say Y here if you have GT911 touch panel.

	  If unsure, say N.

source "drivers/input/touchscreen/mediatek/GT911/Kconfig"

# zhangle zwx450315 20171125 begin.
config TOUCHSCREEN_MTK_GT917D
	bool "GT917D for Mediatek package"
	help
	  Say Y here if you have GT917D touch panel.

	  If unsure, say N.

source "drivers/input/touchscreen/mediatek/GT917D/Kconfig"
# zhangle zwx450315 20171125 end.

config TOUCHSCREEN_FT5X26
	bool "FT5X26 for Mediatek package"
	default n
	help
	  Say Y here if you have FT5X26 touch panel.

	  If unsure, say N.

	  To compile this dirver as a module, choose M here: the
	  module will be called.

source "drivers/input/touchscreen/mediatek/FT5X26/Kconfig"

# zhangle zwx450315 20171128 begin.
config TOUCHSCREEN_FT5436
	bool "FT5436 for Mediatek package"
	default n
	help
	  Say Y here if you have FT5436 touch panel.

	  If unsure, say N.

	  To compile this dirver as a module, choose M here: the
	  module will be called.

source "drivers/input/touchscreen/mediatek/FT5436/Kconfig"
# zhangle zwx450315 20171128 end.

config TOUCHSCREEN_MTK_GSLX680
	bool "gslX680 for Mediatek package"
	help
	  Say Y here if you have gslX680 touch panel.

	  If unsure, say N.

config TOUCHSCREEN_MTK_NT36xxx
	bool "NT36xxx for Mediatek package"
	default n
	help
	  Say Y here if you have NT36xxx touch panel.

	  If unsure, say N.

	  To compile this dirver as a module, choose M here: the
	  module will be called.

source "drivers/input/touchscreen/mediatek/NT36xxx/Kconfig"

endif
```

## drivers/misc/mediatek/imgsensor/Kconfig
```kconfig
config MTK_IMGSENSOR
  bool CONFIG_MTK_IMGSENSOR
  default n
  help
    CONFIG_MTK_IMGSENSOR

config HUAWEI_CAMERA_DSM
  bool CONFIG_HUAWEI_CAMERA_DSM
  default n
  help
    CONFIG_HUAWEI_CAMERA_DSM
source "drivers/misc/mediatek/imgsensor/src/Kconfig"
```

## drivers/misc/mediatek/sensors-1.0/Kconfig
```kconfig
source "drivers/misc/mediatek/sensors-1.0/accelerometer/Kconfig"
source "drivers/misc/mediatek/sensors-1.0/alsps/Kconfig"
source "drivers/misc/mediatek/sensors-1.0/gyroscope/Kconfig"
source "drivers/misc/mediatek/sensors-1.0/magnetometer/Kconfig"
source "drivers/misc/mediatek/sensors-1.0/hwmon/Kconfig"
source "drivers/misc/mediatek/sensors-1.0/barometer/Kconfig"
source "drivers/misc/mediatek/sensors-1.0/accelgyro/Kconfig"
#source "drivers/misc/mediatek/sensors-1.0/humidity/Kconfig"
source "drivers/misc/mediatek/sensors-1.0/activity_sensor/Kconfig"
#source "drivers/misc/mediatek/sensors-1.0/pedometer/Kconfig"
source "drivers/misc/mediatek/sensors-1.0/sensorfusion/Kconfig"
source "drivers/misc/mediatek/sensors-1.0/step_counter/Kconfig"
source "drivers/misc/mediatek/sensors-1.0/situation/Kconfig"
source "drivers/misc/mediatek/sensors-1.0/sensorHub/Kconfig"
source "drivers/misc/mediatek/sensors-1.0/geofence/Kconfig"
source "drivers/misc/mediatek/sensors-1.0/biometric/Kconfig"

config CUSTOM_KERNEL_SAR
	bool "MediaTek Smart Sar Driver"
		help
		Say Y here if you have MediaTek touch panel.
config MTK_SX9320
	bool "MTK_SX9320 for Mediatek package"
	depends on CUSTOM_KERNEL_SAR
```

## drivers/misc/mediatek/sensors-1.0/accelerometer/mc3410-ontim/Kconfig
```kconfig
config MTK_MC3410_ONTIM
	bool "MC3410 for MediaTek package"
	default n
	help
	  It support different accelerometer sensor.
          If this option is set,
	  it will support
          MC3410 Accelerometer.
```

## kernel/die_catch/Kconfig
```kconfig
#
# add HW_DIE_CATCH config
#

config HW_DIE_CATCH
	bool "unexpected die catch feature"
	default y
	help
	  catch a process kill/exit and will transform it SIGABORT
```
